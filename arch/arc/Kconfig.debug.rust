## kernel/Kconfig.exit-rust
```kconfig
# SPDX-License-Identifier: GPL-2.0-only
config RUST_EXIT
	bool "Rust process exit, reparenting and wait"
	depends on RUST
	default y
	help
	  Build all process-exit, process-reparenting, mm-owner replacement,
	  zombie-reaping, wait and waitid syscall algorithms from kernel/exit.rs
	  in the original exit.o slot. Configured layouts and constants come
	  from native headers. Native compiler, locking, architecture and
	  uaccess primitives plus syscall/initcall/export metadata live in
	  exit_helpers.o. Exit-owned data and initializers remain in Rust.
	  All original feature-dependent behavior is retained.

	  The unchanged exit.c is retained for deliberate original-C reference
	  configurations. Rust acceptance must verify CONFIG_RUST_EXIT=y and
	  reject a C exit.o provider before running the original C tests.
```

## kernel/Kconfig.kthread-rust
```kconfig
# SPDX-License-Identifier: GPL-2.0-only
config RUST_KTHREAD
	bool "Rust kernel thread lifecycle and worker implementation"
	depends on RUST
	default y
	help
	  Select Rust as the production owner of kernel/kthread.o. All task
	  creation, park/stop, affinity, worker queue/cancel/flush, address-space
	  switching and block-cgroup association bodies are implemented in Rust
	  using configured native layouts. The original C source is retained
	  for reference and explicit control comparisons.

	  The source retains NUMA, FREEZER, BLK_CGROUP, PREEMPT_RT, lockdep and
	  debug/list behavior. Native compiler, instrumentation, configuration
	  and runtime qualification is still pending; these profiles have not
	  all been validated. The integrated production target must keep this
	  selector enabled and resolve qualification failures explicitly, without
	  silently falling back to the C implementation.
```

## kernel/Kconfig.panic-rust
```kconfig
# SPDX-License-Identifier: GPL-2.0-only
config RUST_PANIC
	bool "Rust panic, warning and taint handling"
	depends on RUST && X86_64 && PRINTK
	depends on RUSTC_VERSION = 108501
	depends on !CFI && !PRINTK_INDEX
	default y
	help
	  Build the panic/warning/oops/taint bodies and owned state from Rust
	  in the original kernel/panic.o slot. C supplies header primitives,
	  weak architecture entry shells and native init/export metadata.
	  The variadic entry points use Rust 1.85.1's real C va_list support.

	  This source batch starts with x86_64 and its native warning ABI.
	  Other architectures, Rust compiler releases, CFI callback type
	  encodings and PRINTK_INDEX metadata require separate acceptance.
	  This option defaults on within those dependencies. Verify the
	  original kernel tests and build artifact provenance when enabling
	  a new configuration. Off explicitly selects unchanged C.
```

## kernel/Kconfig.pid-rust
```kconfig
# SPDX-License-Identifier: GPL-2.0-only
config RUST_PID
	bool "Rust PID management"
	depends on RUST
	default y
	help
	  Build the PID allocator, namespace/task lookup and linkage, pidfd
	  syscall bodies and PID namespace sysctl policy from kernel/pid.rs
	  in the original kernel/pid.o slot. Configured kernel types come
	  from bindgen; macro, locking, refcount and RCU primitives and native
	  ABI metadata use pid_helpers.o. All initial PID and namespace
	  data, flexible-array storage and static relocations remain in Rust.
	  PID_NS, SYSCTL, USER_NS and MULTIUSER retain their original branches.
	  Turning this option off selects the unchanged original C provider.
```

## kernel/Kconfig.softirq-rust
```kconfig
# SPDX-License-Identifier: GPL-2.0-only
config RUST_SOFTIRQ
	bool "Rust softirq dispatch, tasklets and interrupt context"
	depends on RUST && X86_64
	depends on !RANDSTRUCT && !CFI && !GCC_PLUGIN_LATENT_ENTROPY
	default y
	help
	  Select Rust as the sole algorithm/data owner of kernel/softirq.o,
	  including RT and non-RT BH state, dispatch, IRQ context, tasklets,
	  CPU hotplug, softirq/timer daemons and weak IRQ setup defaults.
	  Configured types are generated from the original kernel headers.
	  A native companion emits compiler trace/export/initcall metadata,
	  architecture/atomic operations and explicitly recorded remaining
	  header/subsystem migration dependencies.

	  This selector describes the intended supported x86_64 source scope;
	  a source-only proposal is not evidence of successful compilation or
	  runtime equivalence. The recorded validation gates must pass before
	  accepting any production configuration, including tracing and RT.
	  Original C is retained for deliberate reference/test configurations.
	  Rust production validation must reject an unset selector, C fallback
	  or a duplicate C owner. Other architectures, CFI, randstruct and GCC
	  latent-entropy instrumentation require further work.
```

## kernel/irq/Kconfig.rust-core
```kconfig
# SPDX-License-Identifier: GPL-2.0
config RUST_IRQ_CORE
	bool "Rust interrupt descriptor, dispatch and irqchip core"
	depends on RUST
	default y
	help
	  Select Rust ownership of irqdesc.c, handle.c and chip.c. Configured
	  native layouts are generated from the original kernel headers. The
	  compiler primitive and registration companion contains no original
	  C owner bodies. Sparse and flat descriptor modes, SMP affinity,
	  domain hierarchy, SYSFS and statistics retain their native branches.
	  Existing C IRQ/KUnit tests link against the selected Rust symbols.
	  Disabling this option selects the unchanged original C providers.
```

## mm/Kconfig.rust-migrate
```kconfig
# SPDX-License-Identifier: GPL-2.0
config RUST_MIGRATE
	bool "Rust page and folio migration owner"
	depends on RUST && MIGRATION
	depends on !RANDSTRUCT && !GCC_PLUGIN_LATENT_ENTROPY && !CFI
	default y
	help
	  Build migrate.o from the Rust page/folio migration owner. Native
	  configured types, header/architecture operations, diagnostics and
	  syscall metadata remain supplied by migrate_native_helpers.o.
	  The combined object instrumentation and ABI must pass the coordinated
	  general build-fix review before this owner is admitted to a build.
```

## mm/Kconfig.rust-mprotect
```kconfig
# SPDX-License-Identifier: GPL-2.0
config RUST_MPROTECT
	bool "Use Rust memory protection and protection-key operations"
	depends on RUST && MMU
	depends on !RANDSTRUCT && !GCC_PLUGIN_LATENT_ENTROPY && !CFI
	default y
	help
	  Build mprotect.o from Rust with configured native layouts and ABI.
	  The PTE through PGD protection walks, batch/sub-batch decisions,
	  userfaultfd and NUMA protections, VMA accounting and permission
	  changes, and mprotect/pkey syscall bodies execute in Rust.
	  Native leaves retain architecture/header operations and syscall
	  metadata. The original mprotect.c is preserved as reference only.
	  Native compiler policy checks must pass before build admission.
```

## mm/Kconfig.rust-userfaultfd
```kconfig
# SPDX-License-Identifier: GPL-2.0-only
config RUST_USERFAULTFD
	bool "Rust userfaultfd memory management and file API"
	depends on RUST && USERFAULTFD && MMU
	depends on X86_64 && SMP && CC_IS_CLANG
	depends on !RANDSTRUCT && !GCC_PLUGIN_LATENT_ENTROPY && !CFI
	depends on !KSTACK_ERASE && !RUST_INLINE_HELPERS && !LTO_CLANG && !KCOV
	default y
	help
	  Build userfaultfd.o from the Rust implementation. Page filling,
	  move, write/read-write protection, context lifetime, fault retry,
	  event delivery, ioctl negotiation and access decisions run in Rust.
	  The original C file remains a reference and is not compiled for
	  this object when selected. Native header and architecture leaves
	  retain their configured ABI and instrumentation. This source-phase
	  implementation still requires the combined build and runtime audit.
```
