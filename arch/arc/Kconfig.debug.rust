## arch/arc/Kconfig.debug.rust
```kconfig
# SOURCE-COMMIT: d482bb509b7d065808de40ce78b5bca39f40b783
# SOURCE-SHA256: d93964c40c9d0948d2f643d91dc198a7ac508941bc8a9ec644a08df0446c445c
# REVIEW-CONTEXT: 7290f2d38ef10c1013f60fd60ce3eca79a7031267b1a58d41fd4ee00298f1272
# BUILD-REVIEWER: lupos-build-bash-1
# SPDX-License-Identifier: GPL-2.0

config 16KSTACKS
	bool "Use 16Kb for kernel stacks instead of 8Kb"
	help
	  If you say Y here the kernel will use a  16Kb stacksize for the
	  kernel stack attached to each process/thread. The default is 8K.
	  This increases the resident kernel footprint and will cause less
	  threads to run on the system and also increase the pressure
	  on the VM subsystem for higher order allocations.
```

## arch/x86/Kconfig.rust-address-resource
```kconfig
# SPDX-License-Identifier: GPL-2.0
config RUST_X86_PHYSADDR
	bool "Rust x86-64 physical-address validation owner"
	depends on RUST && X86_64
	default y
	help
	  Use Rust for physaddr.o, including native unsigned address arithmetic,
	  physical-width checks, sparsemem section/subsection lookup and the
	  RCU-sched lifetime. Native generated headers provide all types and
	  constants. Only compiler/preemption/lockdep/bit-access macro leaves
	  remain in the itemized companion; no pfn_valid C body is wrapped.
	  Non-extreme sparsemem, architecture-specific pfn_valid, and unsupported
	  instrumentation profiles fail explicitly in the owner rules.

config RUST_X86_RESOURCE
	bool "Rust x86-64 resource reservation owner"
	depends on RUST && X86_64
	default y
	help
	  Use Rust for resource.o, preserving BIOS/E820 clipping, unsigned
	  wraparound, tie-breaking, configured PCI policy and diagnostic text.
	  Native generated headers provide layouts, declarations and constants.
	  There is no C algorithm companion for this owner. With the reviewed
	  Clang x86-64 SMP strong stack-protector profile, an empty native
	  translation unit supplies the compiler's exact module/guard metadata
	  to strong Rust bitcode before native code generation.
	  Other stack-protector profiles, inline helpers with stack protection,
	  Clang LTO with stack protection, PRINTK_INDEX and unsupported
	  instrumentation fail explicitly. No selected profile falls back to C.
```

## arch/x86/boot/compressed/Kconfig.rust
```kconfig
# SPDX-License-Identifier: GPL-2.0
config RUST_X86_COMPRESSED
	bool "Rust x86-64 gzip extraction and KASLR implementation"
	depends on RUST && X86_64 && KERNEL_GZIP && CC_IS_CLANG
	help
	  Build the compressed kernel's extraction, gzip decoder, KASLR,
	  command-line parsing and error reporting in a freestanding Rust crate.
	  Its core library is rebuilt for the early-boot small-model PIE ABI;
	  the already-decompressed kernel's Rust runtime is never linked here.

	  The retained C files are the reference implementation. Other boot,
	  EFI, startup, memory-encryption, page-table, CPU-feature and console objects still
	  have C production owners and are explicit migration gaps. This option
	  does not establish that the whole boot image is implemented in Rust.
```

## arch/x86/boot/startup/Kconfig.rust
```kconfig
# SPDX-License-Identifier: GPL-2.0
config RUST_X86_STARTUP
	bool "Rust x86-64 initial descriptor tables and kernel mapping"
	depends on RUST && X86_64 && CC_IS_CLANG && LD_IS_LLD && OBJTOOL
	depends on !AMD_MEM_ENCRYPT && !CFI
	default y
	help
	  Build the initial GDT/IDT setup and kernel page-table relocation in
	  an isolated Rust startup crate with native small-model PIC code,
	  size optimization, configured x86 mitigations and the noabs check.
	  Both selected C function owners are excluded when this is enabled.

	  AMD memory encryption and CFI configurations are not yet supported
	  by this owner integration. Original C sources remain the reference
	  and the implementation when this option is disabled. Native entry
	  assembly, inherited storage/aliases and other startup subsystems
	  remain separate migration work; this does not make all startup Rust.
```

## arch/x86/kernel/Kconfig.rust-e820
```kconfig
# SPDX-License-Identifier: GPL-2.0-only
config RUST_X86_E820
	bool "Rust x86-64 E820 memory map owner"
	depends on RUST && X86_64
	default y
	help
	  Use the Rust implementation for the canonical e820.o archive entry.
	  Rust owns map queries, sanitation, mutation, PCI gap selection, boot
	  parameter parsing, firmware ingestion, resources and memblock setup.
	  Configured native headers provide types, constants and provider ABIs.
	  Only BUG, the fixed LA57 CPU-feature compiler predicate, kmemdup's
	  allocation compiler macros and initcall/export metadata use C glue.
	  GCC_PLUGIN_LATENT_ENTROPY and KSTACK_ERASE currently cause explicit
	  errors because their instrumentation parity has not been implemented.
	  The original e820.c remains unchanged.
	  PRINTK_INDEX and Clang KCOV also cause explicit errors until native
	  per-callsite printk index records and per-init-function coverage
	  exemptions are implemented. PRINTK=n preserves the native no-output
	  inline semantics without referring to a nonexistent external symbol.
	  With stack protection enabled, this owner currently requires Clang,
	  x86-64 SMP and strong protection without Clang LTO or inline helpers.
	  An empty C translation unit carries the native compiler's configured
	  guard metadata into the Rust bitcode; it defines no runtime code or
	  data. Object, assembly and IR targets verify the same native policy.
```

## arch/x86/kernel/Kconfig.rust-early-platform
```kconfig
# SPDX-License-Identifier: GPL-2.0
config RUST_X86_EARLY_PLATFORM
	bool "Rust x86-64 early platform owners"
	depends on RUST && X86_64
	default y
	help
	  Build the Rust implementations of ebda.o and platform-quirks.o.
	  Rust owns BIOS memory reservation, initial legacy platform features,
	  subarchitecture quirks and the PNPBIOS-disabled queries. Native
	  configured headers supply data layouts, constants and callee ABIs.
	  The adjacent original C sources remain available for configurations
	  without these Rust owners and are not linked when this is selected.
	  GCC_PLUGIN_LATENT_ENTROPY currently produces an explicit build error:
	  its C init-function instrumentation is not implemented by this owner.
	  Combining RUST_INLINE_HELPERS and KSTACK_ERASE currently produces an
	  explicit build error: the helper-bitcode codegen path has no Rust
	  equivalent of the original C init-only stack-depth exemption.
```

## arch/x86/kernel/Kconfig.rust-head64
```kconfig
# SPDX-License-Identifier: GPL-2.0
config RUST_X86_HEAD64
	bool "Rust x86-64 early boot owner"
	depends on RUST && X86_64
	depends on !GCC_PLUGIN_LATENT_ENTROPY
	default y
	help
	  Select the Rust implementation of arch/x86/kernel/head64.c.
	  Owns the early page tables, exception dispatch, BSS and boot-data
	  initialization, startup ordering and the associated global data.
	  Six small architecture/compiler macro boundaries retain the kernel's
	  paravirtual, per-CPU, page-clear alternative and BUG machinery.
	  The C head64 object is not linked when this option is selected.
```

## arch/x86/kernel/Kconfig.rust-platform-callbacks
```kconfig
# SPDX-License-Identifier: GPL-2.0-only
config RUST_X86_PLATFORM_CALLBACKS
	bool "Rust x86-64 platform callbacks and operation tables"
	depends on RUST && X86_64
	default y
	help
	  Build the Rust owner of x86_init.o, including the platform operation
	  tables and their local callbacks. Configured native headers supply
	  layouts and declarations for other implementation owners.
	  The adjacent C source remains the reference for control builds and
	  is not compiled for this object when this option is selected.
	  Clang with KCOV, KSTACK_ERASE and GCC_PLUGIN_LATENT_ENTROPY currently
	  produce explicit build errors because their init/runtime
	  instrumentation contracts have not been implemented for this owner.
```

## arch/x86/kernel/Kconfig.rust-setup
```kconfig
# SPDX-License-Identifier: GPL-2.0-only
config RUST_X86_SETUP
	bool "Rust x86-64 architecture setup owner"
	depends on RUST && X86_64
	default y
	help
	  Build the configured Rust owner of arch/x86/kernel/setup.o. The
	  original setup.c remains the reference for non-Rust configurations.
	  Existing architecture and subsystem API callees retain their own
	  implementation owners; configured C headers supply their ABI.
```

## arch/x86/mm/Kconfig.rust-init
```kconfig
# SPDX-License-Identifier: GPL-2.0-only
config RUST_X86_MM_INIT
	bool "Rust x86-64 memory initialization owners"
	depends on RUST && X86_64
	default y
	help
	  Select Rust as the canonical init.o and init_64.o owners. Rust owns
	  page-size selection, early page allocation, physical mapping,
	  page-table walking, memory hotplug, vmemmap lifecycle, execmem,
	  rodata protection, and identity mapping through ident_map.rs.
	  Native headers provide the configured type layout and primitive ABI.
	  Macro-only glue retains tracepoints, per-CPU declarations, boot
	  registration, exports, diagnostics and architecture inline primitives.
	  Original C, headers, assembly and tests remain available unchanged.
	  The shared native-policy build route preserves the original stack
	  protection and rejects unreviewed instrumentation combinations.
```

## fs/afs/Kconfig
```kconfig
# SPDX-License-Identifier: GPL-2.0-only
config AFS_FS
	tristate "Andrew File System support (AFS)"
	depends on INET
	select AF_RXRPC
	select DNS_RESOLVER
	select NETFS_SUPPORT
	select CRYPTO_KRB5
	help
	  If you say Y here, you will get an experimental Andrew File System
	  driver. It currently only supports unsecured read-only AFS access.

	  See <file:Documentation/filesystems/afs.rst> for more information.

	  If unsure, say N.

config AFS_DEBUG
	bool "AFS dynamic debugging"
	depends on AFS_FS
	help
	  Say Y here to make runtime controllable debugging messages appear.

	  See <file:Documentation/filesystems/afs.rst> for more information.

	  If unsure, say N.

config AFS_FSCACHE
	bool "Provide AFS client caching support"
	depends on AFS_FS=m && FSCACHE || AFS_FS=y && FSCACHE=y
	help
	  Say Y here if you want AFS data to be cached locally on disk through
	  the generic filesystem cache manager

config AFS_DEBUG_CURSOR
	bool "AFS server cursor debugging"
	depends on AFS_FS
	help
	  Say Y here to cause the contents of a server cursor to be dumped to
	  the dmesg log if the server rotation algorithm fails to successfully
	  contact a server.

	  See <file:Documentation/filesystems/afs.rst> for more information.

	  If unsure, say N.

config RUST_AFS_ADDR_PREFS
	bool "Rust AFS address preference management"
	depends on RUST && AFS_FS
	default n
	help
	  Build addr_prefs.o from its Rust translation. Configured C headers
	  provide the ABI; a small C helper object supplies macro and inline
	  boundaries. The existing kafs module and proc interface are retained.
	  Leave disabled to build the retained original C implementation.
```

## fs/notify/inotify/Kconfig
```kconfig
# SPDX-License-Identifier: GPL-2.0-only
config INOTIFY_USER
	bool "Inotify support for userspace"
	select FSNOTIFY
	default y
	help
	  Say Y here to enable inotify support for userspace, including the
	  associated system calls.  Inotify allows monitoring of both files and
	  directories via a single open fd.  Events are read from the file
	  descriptor, which is also select()- and poll()-able.
	  Inotify fixes numerous shortcomings in dnotify and introduces several
	  new features including multiple file events, one-shot support, and
	  unmount notification.

	  For more information, see <file:Documentation/filesystems/inotify.rst>

	  If unsure, say Y.

config RUST_INOTIFY_USER
	bool "Rust inotify userspace implementation"
	depends on RUST && INOTIFY_USER
	help
	  Build inotify_user.o from its Rust translation. Watch descriptors,
	  user event delivery, syscalls, group allocation and initialization
	  are implemented in Rust. Configured kernel macro, header-inline and
	  syscall declaration boundaries use a dedicated C helper object.
	  The original C provider remains available when this option is off.
```

## fs/orangefs/Kconfig
```kconfig
# SPDX-License-Identifier: GPL-2.0-only
config ORANGEFS_FS
	tristate "ORANGEFS (Powered by PVFS) support"
	select FS_POSIX_ACL
	help
	   Orange is a parallel file system designed for use on high end
	   computing (HEC) systems.

config RUST_ORANGEFS_XATTR
	bool "Rust OrangeFS extended attribute provider"
	depends on RUST && ORANGEFS_FS
	default n
	help
	  Build OrangeFS get/set/remove/list extended attribute control flow
	  and its default xattr handler from xattr.rs, using layouts generated
	  from the configured original C headers. The original xattr.c remains
	  the provider when this option is disabled. Other OrangeFS objects
	  and maintained C tests keep their existing owners.
	  If unsure, say N.
```

## fs/unicode/Kconfig
```kconfig
# SPDX-License-Identifier: GPL-2.0-only
#
# UTF-8 normalization
#
config UNICODE
	tristate "UTF-8 normalization and casefolding support"
	help
	  Say Y here to enable UTF-8 NFD normalization and NFD+CF casefolding
	  support.  If you say M here the large table of case foldings will
	  be a separate loadable module that gets requested only when a file
	  system actually use it.

config RUST_UNICODE_CORE
	bool "Rust Unicode core API provider"
	depends on RUST && UNICODE
	default n
	help
	  Build the nine Unicode core APIs from utf8-core.rs using layouts
	  generated from the configured C headers. Normalization is selected
	  independently; Unicode data and original C KUnit tests keep their
	  existing C owners.
	  Allocation, module-symbol and string-hash macros use C boundaries.
	  If unsure, say N.

config RUST_UNICODE_NORM
	bool "Rust Unicode normalization provider"
	depends on RUST && UNICODE
	default n
	help
	  Build the four normalization APIs from utf8-norm.rs using layouts
	  generated from the configured C headers. This choice is independent
	  of RUST_UNICODE_CORE and replaces the original utf8-norm.o owner.
	  When disabled, the original C normalization engine is the fallback.
	  The original C Unicode tables and C KUnit tests retain their owners.
	  If unsure, say N.

config UNICODE_NORMALIZATION_KUNIT_TEST
	tristate "Test UTF-8 normalization support"
	depends on UNICODE && KUNIT
	default KUNIT_ALL_TESTS
```

## io_uring/Kconfig
```kconfig
# SPDX-License-Identifier: GPL-2.0-only
#
# io_uring configuration
#

config IO_URING_ZCRX
	def_bool y
	depends on IO_URING
	depends on PAGE_POOL
	depends on INET
	depends on NET_RX_BUSY_POLL

config IO_URING_BPF
	def_bool y
	depends on BPF
	depends on NET

config IO_URING_BPF_OPS
	def_bool y
	depends on IO_URING
	depends on BPF_SYSCALL && BPF_JIT && DEBUG_INFO_BTF

config RUST_IO_URING_ZCRX
	bool "Rust io_uring zero-copy receive provider"
	depends on RUST && IO_URING_ZCRX
	default n
	help
	  Select the Rust implementation of the generic io_uring zero-copy
	  receive provider. The original C implementation remains the default.
	  Configured C headers provide the ABI and narrow inline/macro helpers.
```

## ipc/Kconfig
```kconfig
# SPDX-License-Identifier: GPL-2.0
config RUST_SYSVIPC_MSG
	bool "Rust System V message queues"
	depends on RUST && SYSVIPC
	help
	  Build ipc/msg.o from its Rust translation. Queue creation, message
	  transfer, msgctl, namespace lifecycle, compatibility ABI conversion
	  and proc reporting are owned by Rust. Only kernel macro, static-inline
	  and syscall declaration boundaries use the dedicated C helper object.
	  The original C provider is retained when this option is disabled.
```
