## security/selinux/ss/Kconfig.policydb-rust
```kconfig
# SPDX-License-Identifier: GPL-2.0-only
config RUST_SELINUX_POLICYDB
	bool "Rust implementation of SELinux policy database"
	depends on RUST && SECURITY_SELINUX
	default n
	help
	  Build the Rust translation of the SELinux policy database unit.
	  This source reconstruction requires configured ABI, native build,
	  retained-C test and policy round-trip validation before use.
	  If unsure, say N.
```

## virt/lib/Kconfig.rust
```kconfig
# SOURCE-COMMIT: d482bb509b7d065808de40ce78b5bca39f40b783
# SOURCE-SHA256: 2b5c72386d0418b837f0c068794f4a29541eb5dc86a4dbb8312fd41b1d014217
# REVIEW-CONTEXT: 78bba1bbf523147a8ecf775d4e00737834af1dd51170c094a7bf07812bdd3053
# BUILD-REVIEWER: lupos-build-bash-2
# SPDX-License-Identifier: GPL-2.0-only
config IRQ_BYPASS_MANAGER
	tristate
```
